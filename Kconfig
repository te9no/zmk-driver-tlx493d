## Kconfig
```kconfig
rsource "drivers/Kconfig"
rsource "drivers/sensor/tlx493d/Kconfig"

menu "Sensor Drivers"

config INPUT_TLX493D
    bool "TLX493D 3D magnetic sensor driver"
    depends on I2C
    help
      Enable driver for TLX493D 3D magnetic sensor

if INPUT_TLX493D

config TLX493D_CALIBRATION_SAMPLES
    int "Number of samples for calibration"
    default 300
    range 100 1000
    help
      Number of samples to take during initial calibration

config TLX493D_HYSTERESIS_THRESHOLD
    int "Hysteresis threshold (in thousandths)"
    default 100
    range 0 1000
    help
      Hysteresis threshold in thousandths (100 = 0.1)

config TLX493D_CENTER_THRESHOLD
    int "Center deadzone threshold (in thousandths)"
    default 400
    range 0 1000
    help
      Center deadzone threshold in thousandths (400 = 0.4)

endif # INPUT_TLX493D

endmenu
```

## drivers/input/Kconfig
```kconfig
# TLX493D 3D Magnetic Sensor Driver

config INPUT_TLX493D
	bool "TLX493D 3D Magnetic Sensor"
	default y
	depends on DT_HAS_INFINEON_TLX493D_ENABLED
	select INPUT
	help
	  Enable driver for Infineon TLX493D 3D magnetic sensor.
	  This driver provides relative input events for X, Y movement
	  and Z-axis scroll wheel functionality.

config ZMK_INPUT_TLX493D_IDLE_SLEEPER
	bool "TLX493D idle sleeper"
	default y
	depends on INPUT_TLX493D
	help
	  Enable ZMK activity state integration for TLX493D sensor.
	  This automatically puts the sensor to sleep when ZMK is inactive.

if INPUT_TLX493D

config INPUT_TLX493D_POLLING_INTERVAL_MS
	int "Polling interval in milliseconds"
	default 10
	range 1 1000
	help
	  Interval between sensor readings in milliseconds.
	  Lower values provide more responsive input but consume more power.

config INPUT_TLX493D_Z_THRESHOLD
	int "Z-axis scroll threshold"
	default 5
	range 1 100
	help
	  Minimum Z-axis movement required to generate scroll events.
	  Higher values reduce sensitivity but prevent unwanted scrolling.

config INPUT_TLX493D_ROTATION_SCALER
	int "Rotation sensitivity scaler"
	default 20
	range 1 100
	help
	  Scaling factor for Z-axis rotation to scroll conversion.
	  Higher values reduce scroll sensitivity.

config INPUT_TLX493D_LOG_LEVEL
	int "Log level for TLX493D driver"
	default 3
	range 0 4
	help
	  Log level for TLX493D driver.
	  0: Off, 1: Error, 2: Warning, 3: Info, 4: Debug

endif # INPUT_TLX493D
```

## drivers/sensor/tlx493d/Kconfig
```kconfig
# Copyright (c) 2024 The ZMK Contributors
# SPDX-License-Identifier: MIT

config INPUT_TLX493D
    bool "TLX493D 3D magnetic sensor"
    depends on I2C && INPUT
    default y
    help
      Enable driver for Infineon TLX493D 3D magnetic sensor.

if INPUT_TLX493D

config TLX493D_THREAD_PRIORITY
    int "Thread priority"
    default 10
    help
      Priority of thread used by the driver to scan the sensor

config TLX493D_THREAD_STACK_SIZE
    int "Thread stack size"
    default 1024
    help
      Stack size of thread used by the driver

endif # INPUT_TLX493D
```

## dts/bindings/input/infineon,tlx493d.yaml
```yaml
# Copyright (c) 2024 The ZMK Contributors
# SPDX-License-Identifier: MIT

description: Infineon TLX493D 3D Magnetic Sensor

compatible: "infineon,tlx493d"

include: [i2c-device.yaml]

properties:
  reg:
    default: [0x35]
    description: |
      I2C address of the TLX493D sensor.
      Default address is 0x35. Alternative addresses are:
      0x22, 0x44, 0x78
  polling-interval-ms:
    type: int
    default: 10
    description: |
      Polling interval for sensor readings in milliseconds.
      Lower values provide more responsive input but consume more power.

  z-threshold:
    type: int
    default: 5
    description: |
      Minimum Z-axis movement required to generate scroll events.
      Higher values reduce sensitivity but prevent unwanted scrolling.

  rotation-scaler:
    type: int
    default: 20
    description: |
      Scaling factor for Z-axis rotation to scroll conversion.
      Higher values reduce scroll sensitivity.
```

## dts/bindings/sensor/infineon,tlx493d.yaml
```yaml
description: TLX493D 3D Magnetic Sensor

compatible: "infineon,tlx493d"

include: [i2c-device.yaml]

properties:
  reg:
    required: true
    description: I2C address of the sensor

  evt-type:
    type: int
    required: false
    default: 2  # INPUT_EV_REL
    description: Input event type (absolute or relative)

  x-input-code:
    type: int
    required: false
    default: 0
    description: Input code for X axis movement

  y-input-code:
    type: int
    required: false
    default: 1
    description: Input code for Y axis movement

  z-input-code:
    type: int
    required: false
    default: 2
    description: Input code for Z axis movement

  hysteresis:
    type: int
    required: false
    default: 100
    description: Hysteresis threshold in thousandths

  center-threshold:
    type: int
    required: false
    default: 400
    description: Center deadzone threshold in thousandths

  calibration-samples:
    type: int
    required: false
    default: 300
    description: Number of samples for calibration

  polling-interval:
    type: int
    required: false
    default: 10
    description: Polling interval in milliseconds (default 10ms = 100Hz)
```

## src/sensor/tlx493d/Kconfig
```kconfig
# Copyright (c) 2024 The ZMK Contributors
# SPDX-License-Identifier: MIT

config INPUT_TLX493D
    bool "TLX493D 3D magnetic sensor"
    depends on I2C
    help
      Enable driver for Infineon TLX493D 3D magnetic sensor
```
